

#include<arduinoFFT.h>
double raw[75]={-87.17307638,-109.5495333,11.00037444,163.4286511,199.1497693,123.5660003,56.25558579,11.87495703,-18.97729813,-42.98507139,-49.50432452,-44.95819516,-33.93206642,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-17.77934267
};
arduinoFFT FFT = arduinoFFT(); 
const uint16_t samples = 128;
const double samplingfrequency = 25;
double real[128];
double img[128];
double arr[75];

void mean(){
  double sum=0;
  for(int i=0;i<75;i++){
    sum+=raw[i];
  }
  sum/=75;
  for(int i=0;i<75;i++){
    arr[i]=raw[i]-sum;
  }
}



void setup()
{
  Serial.begin(9600);
}
void loop()
{
  for(int i=0;i<128;i++)
  {if(i<75)
    {real[i]=raw[i];
    img[i]=0;}
   else
   {
    real[i]=0;
    img[i]=0;
   }
  }
  FFT.Compute(real,img, samples,FFT_FORWARD);
  FFT.ComplexToMagnitude(real,img,samples);
  double x=FFT.MajorPeak(real,samples,samplingfrequency); // frequency of biggest spike
//  for(int i=0;i<128;i++)
//  {
//    Serial.println(real[i]);
//    delay(10);
//  }
Serial.println(60*x);
}
